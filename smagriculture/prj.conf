## CMakeLists.txt
```
# Find Zephyr. This also loads Zephyr's build system.
cmake_minimum_required(VERSION 3.13.1)
find_package(Zephyr)
project(smagriculture)

# Add your source file to the "app" target. This must come after
# find_package(Zephyr) which defines the target.
target_sources(smagriculture PRIVATE src/main.c)
```

## prj.conf
```kconfig
CONFIG_STDOUT_CONSOLE=y
CONFIG_SENSOR=y
CONFIG_SENSOR_LOG_LEVEL_DBG=y
CONFIG_ADC=y
```

## 96b_wistrio.overlay
```dts
96b_wistrio.overlay 
/*
 * Copyright (c) 2020 Codethink Ltd.
 *
 * SPDX-License-Identifier: TO BE DEFINED
 */

/ {
	&adc1 {
		status="okay"
	};
};
```

## src/main.c
```c
#include <zephyr.h>
#include <drivers/adc.h>

const enum adc_gain ADC_GAIN = ADC_GAIN_1;
const enum adc_reference ADC_REFENCE = ADC_REF_INTERNAL;
const uint16_t ADC_ACQUISITION_TIME = ADC_ACQ_TIME_DEFAULT;
const uint8_t ADC_CHANNEL_ID = 1;

struct adc_channel_cfg adc_config = {
        .gain = ADC_GAIN,
        .reference = ADC_REFENCE,
        .acquisition_time = ADC_ACQUISITION_TIME,
        .channel_id = ADC_CHANNEL_ID,
        .differential = 0,
};



int main (){
    char DEVICE_NAME =  DT_LABEL(DT_NODELABEL("st,stm32-adc"));

    struct device *adc1 = device_get_binding(DEVICE_NAME);
    if (adc1) {
        LOG_ERR("GPIO device " DEVICE_NAME " not found!");
        return -EIO;
    }

    int ch = adc_channel_setup(adc1, &adc_config);

    int value = adc_read(adc1, &adc_config);
    printf("value = %i", value);
}
```
